#include <SPI.h>
#include <WiFi.h>
#include <Wire.h>
#include <Adafruit_GFX.h>
#include <Adafruit_SSD1306.h>
#include <EEPROM.h>
#include <AsyncTimer.h>
#include <Keypad.h>

#define SCREEN_WIDTH 128 // OLED display width, in pixels
#define SCREEN_HEIGHT 64 // OLED display height, in pixels

#define OLED_RESET     -1 // Reset pin # (or -1 if sharing Arduino reset pin)
#define SCREEN_ADDRESS 0x3C ///< See datasheet for Address; 0x3D for 128x64, 0x3C for 128x32
Adafruit_SSD1306 display(SCREEN_WIDTH, SCREEN_HEIGHT, &Wire, OLED_RESET);

#define LOGO_HEIGHT   16
#define LOGO_WIDTH    16
#define RELAY_PIN 15

const char* ssid = "Zero";
const char* password = "zerodev123";
const char* hostname = "Host-Zero 1";

AsyncTimer t;

const byte ROWS = 4; //four rows
const byte COLS = 4; //four columns
//define the cymbols on the buttons of the keypads
char hexaKeys[ROWS][COLS] = {
  {'1','2','3','A'},
  {'4','5','6','B'},
  {'7','8','9','C'},
  {'*','0','#','D'}
};
byte rowPins[ROWS] = {32, 33, 25, 26}; //connect to the row pinouts of the keypad
byte colPins[COLS] = {27, 14, 12, 13}; //connect to the column pinouts of the keypad

//initialize an instance of class NewKeypad
Keypad customKeypad = Keypad( makeKeymap(hexaKeys), rowPins, colPins, ROWS, COLS); 

static const uint8_t logo_zero_dev[1024] = {
    0xff, 0xff, 0xff, 0xff, 0xff, 0xff, 0xff, 0xff, 0xff, 0xff, 0xff, 0xff, 0xff, 0xff, 0xff, 0xff, 
  0xff, 0xff, 0xff, 0xff, 0xff, 0xff, 0xff, 0xff, 0xff, 0xff, 0xff, 0xff, 0xff, 0xff, 0xff, 0xff, 
  0xff, 0xff, 0xff, 0xff, 0xff, 0xff, 0xff, 0xff, 0xff, 0xff, 0xff, 0xff, 0xff, 0xff, 0xff, 0xff, 
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  0xff, 0xff, 0xff, 0xff, 0xff, 0xff, 0xff, 0xff, 0xff, 0xff, 0xff, 0xff, 0xff, 0xff, 0xff, 0xff
};

unsigned char wifi1_icon4[] =
{
  0b00000000, 0b00000000, //                 
  0b00000111, 0b11100000, //      ######     
  0b00011111, 0b11111000, //    ##########   
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  0b00000000, 0b00000000, //                 
};

 unsigned char wifi1_icon3[] =
{
  0b00000000, 0b00000000, //                 
  0b00000000, 0b00000000, //    
  0b00000000, 0b00000000, //    
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  0b00000000, 0b00000000, //                 
};


 unsigned char wifi1_icon2[] =
{
  0b00000000, 0b00000000, //                 
  0b00000000, 0b00000000, //                 
  0b00000000, 0b00000000, //                 
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  0b00000000, 0b00000000, //                 
};

 unsigned char wifi1_icon1[] =
{
  0b00000000, 0b00000000, //                 
  0b00000000, 0b00000000, //                 
  0b00000000, 0b00000000, //                 
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  0b00000000, 0b00000000, //                 
};

 unsigned char wifi1_icon0[] =
{
  0b00000000, 0b00000000, //                 
  0b00000000, 0b00000000, //                 
  0b00111000, 0b00001110, //   ###       ### 
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  0b00000000, 0b00000000, //                 
};

int eepromOffset = 0;
unsigned short timeoutId;
byte menuCount = 1;

// 0 -> Main
// 1 -> Menu Setting
// 2 -> Password
byte dashboardCount = 0;

void(* resetFunc) (void) = 0; 

void setup() {
  Serial.begin(9600);
  pinMode(RELAY_PIN, OUTPUT);

  // SSD1306_SWITCHCAPVCC = generate display voltage from 3.3V internally
  if(!display.begin(SSD1306_SWITCHCAPVCC, SCREEN_ADDRESS)) {
    Serial.println(F("SSD1306 allocation failed"));
    for(;;); // Don't proceed, loop forever
  }
  digitalWrite(RELAY_PIN, HIGH);
  display.clearDisplay();
  display.drawBitmap(0, 0, logo_zero_dev, 128, 64, 1);
  display.display();
  delay(2000);
  display.clearDisplay();
  
  initWiFi();
  timeoutId = t.setTimeout([]() {
    timeOut();
  }, 6000);
}

void loop() {
//  delay(50);
  getButtonInput();
  if (dashboardCount == 0){
    delay(100);
    t.handle();
    display.clearDisplay();
    display.setTextSize(1);        
    
    // wifi signal connection
    if (WiFi.RSSI() >= -50){
      display.drawBitmap(0, 0, wifi1_icon4, 16, 16, 1);
    }else if ((WiFi.RSSI() < -50) &&  (WiFi.RSSI() > -70)){
      display.drawBitmap(0, 0, wifi1_icon3, 16, 16, 1);
    }else if ((WiFi.RSSI() < -70) &&  (WiFi.RSSI() > -80)){
      display.drawBitmap(0, 0, wifi1_icon2, 16, 16, 1);
    }else {
      display.drawBitmap(0, 0, wifi1_icon1, 16, 16, 1);
    }
    display.setCursor(18,4);             
    display.println(WiFi.localIP());
  
    // timmer
    unsigned long currentMillis = t.getRemaining(timeoutId);
    unsigned long seconds = currentMillis / 1000;
    unsigned long minutes = seconds / 60;
    unsigned long hours = minutes / 60;
    unsigned long days = hours / 24;                    
    currentMillis %= 1000;
    seconds %= 60;
    minutes %= 60;
    hours %= 24;                
    String hrMinSec = (String(hours) + ":" + String(minutes) + ":" + String(seconds));
    display.setTextSize(2);          
    display.setCursor(0,27);
    display.println(hrMinSec);
    digitalWrite(RELAY_PIN, LOW);
    display.display();
    if (WiFi.status() != WL_CONNECTED) {
      Serial.println("Reconnecting to WiFi...");
      WiFi.disconnect();
      initWiFi();
    }
    Serial.printf("RSSI: %d dBm\n", WiFi.RSSI());
  } else if (dashboardCount == 1){
    digitalWrite(RELAY_PIN, HIGH);
    staticMenu();
    display.clearDisplay();
  }
  
}


void initWiFi() {
  WiFi.mode(WIFI_STA);
  WiFi.setHostname(hostname);
  WiFi.begin(ssid, password);
  display.clearDisplay();
  display.setTextSize(1);             
  display.setTextColor(WHITE);        
  display.setCursor(0,20);             
  display.println("Connecting to WiFi ..");
  display.display();
  
  Serial.print("Connecting to WiFi ..");
  while (WiFi.status() != WL_CONNECTED) {
    Serial.print('.');
    delay(1000);
  }
  
  Serial.println(WiFi.localIP());
}

void timeOut() {
  display.clearDisplay();
  display.setTextSize(1);   
  display.setCursor(0,15);
  digitalWrite(RELAY_PIN, HIGH);
  display.println("Waktu Habis!! :)");
  display.display();  
  delay(2000);
  timeoutId = t.setTimeout([]() {
    timeOut();
  }, 6000);
}


void staticMenu() {
  // change text display here
  display.setTextSize(1);
  display.setTextColor(WHITE);

  display.setCursor(10, 0);
  // menu title
  display.println("Menu Setting");
  //---------------------------------
  display.drawLine(5, 12, 118, 12, WHITE);
  display.setTextSize(1);
  display.setCursor(10, 20);
  // edit menu item here
  display.println("Reconnect WiFi");
  display.setCursor(60, 20);

  display.setCursor(10, 30);
  // edit menu item here
  display.println("Mode Setup");
  display.setCursor(60, 30);

  display.setCursor(10, 40);
  // edit menu item here
  display.println("Device Info");
  display.setCursor(60, 40);

  display.setCursor(10, 50);
  // edit menu item here
  display.println("Reboot");
  display.setCursor(45, 50);
  
  // prints the cursor to highlight menu items
  display.setCursor(2, (menuCount * 10) + 10);
  display.println(">");

  display.display();
}

void getButtonInput() {
  char customKey = customKeypad.getKey();
  if (customKey) {
    if (dashboardCount == 0) {
      if (customKey == '1'){
        t.delay(timeoutId, 600000);
      }
      if (customKey == '#'){
        dashboardCount=1;
      }
    }else if (dashboardCount == 1){
      if (customKey == 'A'){
        if (menuCount <= 1)
          menuCount = 4;
        else
          menuCount--; 
      }
  
      if (customKey == 'C'){
          if (menuCount >= 4)
            menuCount = 1;
          else
            menuCount++; 
      }
  
      if (customKey == 'B'){
       if (menuCount == 1)
        // menu item 1 clicked
        initWiFi();
      else if (menuCount == 2)
        // menu item 2 clicked
        function_two();
      else if (menuCount == 3)
        // menu item 2 clicked
        function_three();
      else if (menuCount == 4)
        // menu item 3 clicked
        resetFunc(); 
      }
    }
  }
  
}

void function_one() {
  // insert fuction code form menu item 1 here
  Serial.println("Function 1");
}

void function_two() {
  // insert fuction code form menu item 2 here
  dashboardCount = 0;
}

void function_three() {
  // insert fuction code form menu item 3 here
  Serial.println("Function 3");
}

void function_four() {
  // insert fuction code form menu item 4 here
  Serial.println("Function 4");
}
